## drivers/gpu/arm/Kconfig
```kconfig
#
# (C) COPYRIGHT 2017 Rockchip Electric Co., LTD. All rights reserved.
#
# This program is free software and is provided to you under the terms of the
# GNU General Public License version 2 as published by the Free Software
# Foundation, and any use by you of this program is subject to the terms
# of such GNU licence.
#
# A copy of the licence is included with the program, and can also be obtained
# from Free Software Foundation, Inc., 51 Franklin Street, Fifth Floor,
# Boston, MA  02110-1301, USA.
#
#
#
source "drivers/gpu/arm/mali400/mali/Kconfig"

choice
	prompt "Mali Midgard driver"

config MALI_MIDGARD_FOR_LINUX
	bool "Mali Midgard for Linux only"

config MALI_MIDGARD_FOR_ANDROID
	bool "Mali Midgard for Android"

endchoice

source "drivers/gpu/arm/midgard/Kconfig"
```
